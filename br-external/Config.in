## br-external/Config.in
```kconfig
menu "ArcadeOS"

config BR2_ARCADEOS_RELEASE
	bool "Release-Build (nur Release-Keys fuer Updates)"
	help
	  Release-Build fuer echte Geraete: arcadeos-update akzeptiert nur Pakete, die mit einem
	  Release-Key (keys/trusted/release/*.pub, Schluessel des Users) signiert sind.
	  Ohne diese Option (Dev-Build, z.B. fuer QEMU) wird zusaetzlich der Build-Key
	  (keys/trusted/dev/*.pub) akzeptiert und jedes Paket automatisch damit signiert.


source "$BR2_EXTERNAL_ARCADEOS_PATH/package/meshd/Config.in"

endmenu
```

## br-external/package/meshd/Config.in
```kconfig
config BR2_PACKAGE_MESHD
	bool "meshd"
	depends on BR2_PACKAGE_HOST_RUSTC_TARGET_ARCH_SUPPORTS
	select BR2_PACKAGE_HOST_RUSTC
	help
	  ArcadeOS Mesh-Dienst: spricht das Mesh-Protokoll der Arcades
	  (docs/mesh-protocol.md) und haelt Verbindungen zu Live-Arcades.
```
